#include <Arduino.h>
#include <IRremoteESP8266.h>
#include <IRsend.h>

const uint16_t  SEND_PIN = 4;
IRsend irsend(SEND_PIN);

uint16_t powerRaw[99] = {8926, 4404, 590, 1634, 596, 520, 596, 520, 596, 520, 596, 520, 596,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 1634, 590};

uint16_t swingRaw[99] = {8924, 4408, 592, 1634, 590, 526, 590, 528, 588, 528, 588, 528, 592,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 1638, 592};

uint16_t modeRaw[99] = {8920, 4406, 588, 1636, 588, 528, 588, 528, 588, 528, 588, 528, 588,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 1634, 590};

uint16_t speedDownRaw[99] = {8924, 4408, 592, 1634, 590, 526, 590, 526, 590, 526, 590, 526, 590,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 1634, 590};

uint16_t speedUpRaw[99] = {8924, 4408, 588, 1636, 588, 528, 588, 528, 588, 528, 588, 528, 588,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 1634, 590};

uint16_t timerRaw[99] = {8926, 4404, 590, 1634, 590, 526, 590, 528, 588, 528, 588, 528, 588,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 1636, 588};

uint16_t lockRaw[99] = {8922, 4404, 592, 1634, 590, 526, 590, 526, 590, 526, 590, 526, 590,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 1634, 590};

void txinit() {
    irsend.begin();
    Serial.println("Ready. Type a command:");
    Serial.println("power / swing / mode / speedup / speeddown / timer / lock");
}

void sendCode (uint16_t* raw, const char* label) {
  irsend.sendRaw(raw, 99, 38);
  Serial.print("Sent: ");
  Serial.println(label);
}

void commandLogics() {
    if (Serial.available()) {
    String cmd = Serial.readStringUntil('\n');
    cmd.trim();

    if (cmd == "power") sendCode(powerRaw, "Power");
    else if (cmd == "swing") sendCode(swingRaw, "Swing");
    else if (cmd == "mode") sendCode(modeRaw, "Fan Mode");
    else if (cmd == "speedup") sendCode(speedUpRaw, "Speed +");
    else if (cmd == "speeddown") sendCode(speedDownRaw, "Speed -");
    else if (cmd == "timer") sendCode(timerRaw, "Timer");
    else if (cmd == "lock") sendCode(lockRaw, "Lock");
    else Serial.println("Unknown command");
  }
}
